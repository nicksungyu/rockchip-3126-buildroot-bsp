## buildroot/configs/rockchip_rk312x_defconfig
```kconfig
#include "rk312x_arm.config"
#include "base.config"
#include "base_extra.config"
#include "gpu.config"
#include "display.config"
#include "video_mpp.config"
#include "audio.config"
#include "wifi.config"
#include "network.config"
BR2_TARGET_GENERIC_HOSTNAME="rk312x"
BR2_TARGET_GENERIC_ISSUE="Welcome to RK312X Buildroot"
# BR2_PACKAGE_RKWIFIBT_AP6212A1 is not set
# BR2_PACKAGE_RKWIFIBT_BTUART is not set
# BR2_PACKAGE_MINIGUI_SOFTWARE_SCALE is not set
# BR2_PACKAGE_DEVICEIO_RELEASE is not set
BR2_PACKAGE_GDB=y
BR2_PACKAGE_GDB_DEBUGGER=y
# BR2_PACKAGE_HICOLOR_ICON_THEME is not set
BR2_PACKAGE_SDL2=y
# BR2_PACKAGE_SDL2_KMSDRM is not set
BR2_PACKAGE_SDL2_WAYLAND=y
BR2_PACKAGE_SDL2_OPENGLES=y
BR2_PACKAGE_SDL2_GFX=y
BR2_PACKAGE_SDL2_IMAGE=y
BR2_PACKAGE_SDL2_MIXER=y
BR2_PACKAGE_SDL2_NET=y
BR2_PACKAGE_SDL2_TTF=y
# BR2_PACKAGE_QT5_GL_AVAILABLE is not set
BR2_PACKAGE_XKEYBOARD_CONFIG=y
BR2_PACKAGE_SBC=y
# BR2_PACKAGE_CAIRO is not set
# BR2_PACKAGE_CAIRO_PNG is not set
BR2_PACKAGE_LIBINPUT=y
BR2_PACKAGE_LIBXKBCOMMON=y
BR2_PACKAGE_LIBBSD=y
BR2_PACKAGE_PCRE2=y
BR2_PACKAGE_PCRE2_16=y
BR2_PACKAGE_WIRELESS_TOOLS=y
BR2_PACKAGE_WIRELESS_TOOLS_LIB=y
BR2_PACKAGE_IW=y
BR2_PACKAGE_LIBUSB=y
BR2_PACKAGE_STRACE=y
BR2_PACKAGE_JPEG=y
BR2_PACKAGE_EVTEST=y
BR2_PACKAGE_BTE_OTA=y
BR2_PACKAGE_BTE_MENU=y
BR2_PACKAGE_LIBOPENSSL=y
BR2_PACKAGE_LIBOPENSSL_BIN=y
BR2_PACKAGE_EASY_RSA=y
```
